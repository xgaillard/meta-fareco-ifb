## conf/layer.conf
```bitbake
# We have a conf and classes directory, add to BBPATH
BBPATH .= ":${LAYERDIR}"

# We have recipes-* directories, add to BBFILES
BBFILES += "${LAYERDIR}/recipes-*/*/*.bb \
            ${LAYERDIR}/recipes-*/*/*.bbappend"

BBFILE_COLLECTIONS += "meta-fareco"
BBFILE_PATTERN_meta-fareco = "^${LAYERDIR}/"
BBFILE_PRIORITY_meta-fareco = "30"

LAYERSERIES_COMPAT_meta-fareco = "hardknott"
 
SECURITY_PATH = "${TOPDIR}/../security"
```

## conf/machine/ifb.conf
```bitbake
#@TYPE: Machine
#@NAME: Axiomtek IFB122 Embedded System
#@SOC: i.MX6UL
#@DESCRIPTION: Machine configuration for Fareco Axiomtek IFB122 Embedded System
#
include conf/machine/include/ifb122.conf

IMAGE_INSTALL_append = " \
			 lighttpd lighttpd-module-openssl lighttpd-module-proxy \
			 openjdk-8 \
"
```
